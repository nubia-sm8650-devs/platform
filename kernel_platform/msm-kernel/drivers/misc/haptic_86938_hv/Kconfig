## kernel_platform/msm-kernel/drivers/misc/haptic_86938_hv/Kconfig
```kconfig
#
# Qcom AWINIC_HAPTIC_HV Driver
#

config AWINIC_86938_HAPTIC_HV
	tristate "AWINIC_86938_HAPTIC_HV driver"
	depends on I2C
	help
	  Say Y here if you have Awinic AW869X/AW869XX/AW86938X haptic controller
	  chip in your system.
	  If unsure, say N.
	  To compile this driver as a module, choose M here: the
	  module will be called awinic_haptic_hv.
```

## kernel_platform/msm-kernel/drivers/nfc/nxpwlc/Kconfig
```kconfig
#
# Nxp NFC wireless(I2C) devices
#

config NFC_CTN730
	tristate "NCI based NFC Driver for CTN730"
	depends on I2C
	help
	  This enables the NFC driver for CTN730 based devices.
	  This is for i2c connected with NFC controller.
	
```

## kernel_platform/msm-kernel/drivers/vendor/common/fan/Kconfig
```kconfig
#
# Fan driver configuration
#
config SOC_FAN
        tristate "Soc Fan"
        default n
       help
          Say Y here if you use soc control fan.

config PANAX_FAN
        bool "Choose Power Supply For FAN"
        default n
        help
           panax fan use qcom pmic power,this is needed to config y

#config FAN_UPDATA
#	bool "Fan updata"
#	default n
```

## kernel_platform/msm-kernel/drivers/vendor/soc/qcom/btkeyboard/Kconfig
```kconfig
config ZTE_BTKEYBOARD
	tristate "zte driver for btkeyboard power control"
	help
	  btkeyboard driver for PAD keyboard message.

config ZTE_KEYBOARD_DOCK
	tristate "zte driver for keypad dock"
	depends on KEYBOARD_GPIO
	default n
	help
	  keypad dock driver
```
