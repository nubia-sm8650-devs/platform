&mdss_mdp {
    dsi_bf068_hx8394d_10p99_dsc_144hz_video_dphy: qcom,mdss_dsi_bf068_hx8394d_10p99_dsc_144hz_video_dphy {
        qcom,mdss-dsi-panel-name = "hx8394d 144hz video mode panel with DSC";
		qcom,mdss-dsi-panel-type = "dsi_video_mode";
		//the panel ic is NT36532, json name relate with this, so don't change now
		qcom,dsi-ctrl-num = <0 1>;
		qcom,dsi-phy-num = <0 1>;

		qcom,mdss-dsi-virtual-channel-id = <0>;
		qcom,mdss-dsi-stream = <0>;
		qcom,mdss-dsi-bpp = <24>;
		qcom,mdss-dsi-border-color = <0>;
        qcom,mdss-dsi-traffic-mode = "non_burst_sync_event";
		qcom,mdss-dsi-bllp-eof-power-mode;
		qcom,mdss-dsi-bllp-power-mode;
        qcom,mdss-dsi-lp11-init;
        qcom,mdss-dsi-color-order = "rgb_swap_rgb";
		qcom,mdss-dsi-lane-0-state;
		qcom,mdss-dsi-lane-1-state;
		qcom,mdss-dsi-lane-2-state;
		qcom,mdss-dsi-lane-3-state;
		qcom,mdss-dsi-dma-trigger = "trigger_sw";
		qcom,mdss-dsi-mdp-trigger = "none";
		qcom,mdss-dsi-reset-sequence = <1 5>, <0 5>, <1 5>, <0 5>, <1 10>;
        qcom,mdss-pan-physical-width-dimension = <148>;
        qcom,mdss-pan-physical-height-dimension = <237>;
		qcom,mdss-dsi-tx-eot-append;

		qcom,adjust-timer-wakeup-ms = <1>;
		qcom,mdss-dsi-panel-hdr-enabled;
		qcom,mdss-dsi-panel-hdr-color-primaries = <14500 15500 32000
			17000 15500 30000 8000 3000>;
		qcom,mdss-dsi-panel-peak-brightness = <4200000>;
		qcom,mdss-dsi-panel-blackness-level = <3230>;

		qcom,mdss-dsi-display-timings {
			timing@0 {
				cell-index = <0>;
				qcom,mdss-dsi-panel-width = <900>; // 1800/2
				qcom,mdss-dsi-panel-height = <2880>;
                qcom,mdss-dsi-h-pulse-width = <2>;
                qcom,mdss-dsi-h-back-porch = <46>;
                qcom,mdss-dsi-h-front-porch = <100>;
                qcom,mdss-dsi-h-sync-skew = <0>;
                qcom,mdss-dsi-v-pulse-width = <2>;
                qcom,mdss-dsi-v-back-porch = <214>;
                qcom,mdss-dsi-v-front-porch = <26>;
                qcom,mdss-dsi-h-left-border = <0>;
                qcom,mdss-dsi-h-right-border = <0>;
                qcom,mdss-dsi-v-top-border = <0>;
                qcom,mdss-dsi-panel-clockrate = <1009476000>; //1007030000
		qcom,mdss-dsi-panel-framerate = <120>;
		//qcom,mdss-dsi-panel-clockrate = <1007030000>; //60HZ
		//qcom,mdss-dsi-panel-clockrate = <1008160000>; //90HZ
		//qcom,mdss-dsi-panel-clockrate = <1008830000>; //144HZ
				qcom,mdss-dsi-on-command = [
				//fps switch
					39 01 00 00 00 00 02 FF 20
					39 01 00 00 00 00 02 FB 01
					39 01 00 00 00 00 02 17 11

					39 01 00 00 00 00 02 FF 2A
					39 01 00 00 00 00 02 FB 01
					39 01 00 00 00 00 02 30 03

					//ESD init
					39 01 00 00 00 00 02 FF 24
					39 01 00 00 00 00 02 FB 01
					39 01 00 00 00 00 02 DA 01

					39 01 00 00 00 00 02 FF 23
					39 01 00 00 00 00 02 FB 01
					39 01 00 00 00 00 02 00 80
					39 01 00 00 00 00 02 01 84
					39 01 00 00 00 00 02 05 2D
					39 01 00 00 00 00 02 06 00
					39 01 00 00 00 00 02 11 03
					39 01 00 00 00 00 02 12 2A
					39 01 00 00 00 00 02 15 D0
					39 01 00 00 00 00 02 16 16

					39 01 00 00 00 00 02 FF E0
					39 01 00 00 00 00 02 FB 01
					39 01 00 00 00 00 02 14 60
					39 01 00 00 00 00 02 16 C0

					39 01 00 00 00 00 02 FF 20
					39 01 00 00 00 00 02 FB 01
					39 01 00 00 00 00 02 0D 43
					39 01 00 00 00 00 02 32 72
					39 01 00 00 00 00 02 69 DD
					39 01 00 00 00 00 02 17 11
					39 01 00 00 00 00 02 FF 21
					39 01 00 00 00 00 02 FB 01
					39 01 00 00 00 00 02 BC 00
					39 01 00 00 00 00 02 FF 24
					39 01 00 00 00 00 02 FB 01
					39 01 00 00 00 00 02 FA 03
					39 01 00 00 00 00 02 BC 22
					39 01 00 00 00 00 02 FF 25
					39 01 00 00 00 00 02 FB 01
					39 01 00 00 00 00 02 0F 20
					39 01 00 00 00 00 02 C1 46
					39 01 00 00 00 00 02 FF 27
					39 01 00 00 00 00 02 FB 01
					39 01 00 00 00 00 02 13 06
					39 01 00 00 00 00 02 50 00
					39 01 00 00 00 00 02 FF 2A
					39 01 00 00 00 00 02 FB 01
					39 01 00 00 00 00 03 B1 00 01
					39 01 00 00 00 00 02 30 03

					39 01 00 00 00 00 02 FF 10
					39 01 00 00 00 00 02 FB 01
					39 01 00 00 00 00 07 3B 03 D8 1A 0A 0A 00
					39 01 00 00 00 00 02 90 03
					39 01 00 00 00 00 11 91 89 28 00 14 D2 00 01 F4 01 AB 00 06 05 7A 06 1A
					39 01 00 00 00 00 03 92 10 F0
					39 01 00 00 00 00 02 9D 01
					39 01 00 00 00 00 02 B2 91
					39 01 00 00 00 00 02 B3 40
					39 01 00 00 00 00 02 35 00
					39 01 00 00 00 00 03 51 00 00
					39 01 00 00 00 00 03 68 04 01
					39 01 00 00 00 00 02 53 24
					39 01 00 00 78 00 01 11
					39 01 00 00 14 00 01 29
				];
				qcom,mdss-dsi-on-command-state = "dsi_lp_mode";
				qcom,mdss-dsi-off-command =
					[05 01 00 00 14 00 02 28 00
					 05 01 00 00 78 00 02 10 00];
				qcom,mdss-dsi-off-command-state = "dsi_lp_mode";

				qcom,compression-mode = "dsc";
				qcom,mdss-dsc-version = <0x11>;
				qcom,mdss-dsc-scr-version = <0x0>;
				qcom,mdss-dsc-slice-height = <20>;
				qcom,mdss-dsc-slice-width = <450>;
				qcom,mdss-dsc-slice-per-pkt = <2>;
				qcom,mdss-dsc-bit-per-component = <8>;
				qcom,mdss-dsc-bit-per-pixel = <8>;
				qcom,mdss-dsc-block-prediction-enable;
				qcom,mdss-dsi-switch144-commands = [
					39 00 00 40 00 00 02 FF 10
					39 00 00 00 00 00 02 B2 80
				];
				qcom,mdss-dsi-switch120-commands = [
					39 00 00 40 00 00 02 FF 10
					39 00 00 00 00 00 02 B2 91
				];
				 qcom,mdss-dsi-switch60-commands = [
					39 00 00 40 00 00 02 FF 10
					39 00 00 00 00 00 02 B2 91
				];
				 qcom,mdss-dsi-switch90-commands = [
					39 00 00 40 00 00 02 FF 10
					39 00 00 00 00 00 02 B2 80
				];
				 zte,mdss-dsi-reg-read-commands = [
					06 01 00 00 00 00 01 A0
				];
				 zte,mdss-dsi-dim-on-commands = [
					39 01 00 00 00 00 02 FF 10
					39 01 00 00 00 00 02 FB 01
					39 01 00 00 00 00 02 53 2C
				];
				zte,mdss-dsi-acl-off-commands = [
					39 01 00 00 00 00 02 FF 10
					39 01 00 00 00 00 02 FB 01
					39 01 00 00 00 00 02 55 00
				];
				zte,mdss-dsi-acl-low-commands = [
					39 01 00 00 00 00 02 FF 10
					39 01 00 00 00 00 02 FB 01
					39 01 00 00 00 00 02 55 01
				];
				zte,mdss-dsi-acl-mid-commands = [
					39 01 00 00 00 00 02 FF 10
					39 01 00 00 00 00 02 FB 01
					39 01 00 00 00 00 02 55 02
				];
				zte,mdss-dsi-acl-high-commands = [
					39 01 00 00 00 00 02 FF 10
					39 01 00 00 00 00 02 FB 01
					39 01 00 00 00 00 02 55 03
				];
			qcom,mdss-dsi-switch120-commands-state = "dsi_lp_mode";
			qcom,mdss-dsi-switch60-commands-state = "dsi_lp_mode";
			qcom,mdss-dsi-switch144-commands-state = "dsi_lp_mode";
			qcom,mdss-dsi-switch90-commands-state = "dsi_lp_mode";
			zte,mdss-dsi-reg-read-commands-state = "dsi_lp_mode";
			zte,mdss-dsi-dim-on-commands-state = "dsi_lp_mode";
			zte,mdss-dsi-acl-off-commands-state = "dsi_lp_mode";
			zte,mdss-dsi-acl-low-commands-state = "dsi_lp_mode";
			zte,mdss-dsi-acl-mid-commands-state = "dsi_lp_mode";
			zte,mdss-dsi-acl-high-commands-state = "dsi_lp_mode";
			};
		};
	};
};
&dsi_bf068_hx8394d_10p99_dsc_144hz_video_dphy {
		qcom,panel-supply-entries = <&dsi_panel_pwr_supply_hx8394d>;
		qcom,platform-bklight-en-gpio = <&tlmm 88 0>;
		qcom,mdss-dsi-bl-pmic-control-type = "bl_ctrl_dcs";	
		qcom,dsi-ctrl-num = <0 1>;
		qcom,dsi-phy-num = <0 1>;
		//qcom,dsi-select-clocks = "mux_byte_clk0", "mux_pixel_clk0";
		qcom,dsi-select-clocks = "pll_byte_clk0", "pll_dsi_clk0";
		qcom,mdss-dsi-clk-strength = <0xFF>;
		qcom,mdss-dsi-bl-min-level = <25>;
		qcom,mdss-dsi-bl-max-level = <4095>;
		qcom,mdss-brightness-max-level = <2047>;
		qcom,platform-reset-gpio = <&tlmm 133 0>;
		qcom,mdss-dsi-bl-inverted-dbv;
		qcom,ulps-enabled;

		qcom,dsi-supported-dfps-list = <120 144 90 60>;
		qcom,mdss-dsi-pan-enable-dynamic-fps;
		qcom,mdss-dsi-pan-fps-update = "dfps_immediate_porch_mode_vfp";
	zte,mdss-dsi-dfps-dec-vfp-list = <26 26 26 3148>;
	zte,mdss-dsi-dfps-dec-hfp-list = <100 26 250 100>;
	zte,mdss-dsi-dfps-dec-hsa-list = <2 2 2 2>;
	zte,mdss-dsi-dfps-dec-hbp-list = <46 46 46 46>;
	zte,mdss-dsi-pan-hfp-vfp-switch;
	zte,lcd_gesture;
	zte,acl_enabled;
	zte,color_space_enabled;
	zte,bl_limit_enabled;

		qcom,mdss-dsi-display-timings {
			timing@0 {
				qcom,mdss-dsi-panel-phy-timings = [00 22 08 09 19 17 09
						09 09 02 04 00 1C 0E];
				qcom,display-topology = <2 2 2>;
				qcom,default-topology-index = <0>;
		};
	};
};
